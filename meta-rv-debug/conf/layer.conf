## meta-rv-debug/conf/layer.conf
```bitbake
# We have a conf and classes directory, add to BBPATH
BBPATH .= ":${LAYERDIR}"

# We have recipes-* directories, add to BBFILES
BBFILES += "${LAYERDIR}/recipes-*/*.bb \
	        ${LAYERDIR}/recipes-*/*.bbappend \
            ${LAYERDIR}/recipes-*/*/*.bb \
	        ${LAYERDIR}/recipes-*/*/*.bbappend"

BBFILE_COLLECTIONS += "rv-debug"
BBFILE_PATTERN_rv-debug := "^${LAYERDIR}/"
BBFILE_PRIORITY_rv-debug = "8"

RV_DEBUG_LICENSES = '${@os.path.normpath("${LAYERDIR}/licenses")}'
BB_BASEHASH_IGNORE_VARS:append = " RV_DEBUG_LICENSES"

# Additional license directories.
LICENSE_PATH += "${LAYERDIR}/licenses"

LAYERDEPENDS_rv-debug = "core openembedded-layer rv110x"

# This should only be incremented on significant changes that will
# cause compatibility issues with other layers
LAYERVERSION_rv-debug = "1"
LAYERSERIES_COMPAT_rv-debug = "walnascar"
```
